## conf/layer.conf
```bitbake
# We have a conf and classes directory, add to BBPATH
BBPATH =. "${LAYERDIR}:"

# We have recipes-* directories, add to BBFILES
BBFILES += "${LAYERDIR}/recipes-*/*/*.bb \
            ${LAYERDIR}/recipes-*/*/*.bbappend"

BBFILE_COLLECTIONS += "metrics"
BBFILE_PATTERN_metrics = "^${LAYERDIR}/"
BBFILE_PRIORITY_metrics = "20"
LAYERSERIES_COMPAT_metrics = "dunfell"
```
